## idf/willow-build/Kconfig.projbuild
```kconfig
menu "Willow Configuration"

choice WILLOW_HARDWARE
    prompt "Willow hardware"
    default ESP32_S3_BOX_3_BOARD

config ESP32_S3_BOX_BOARD
    bool "ESP32-S3-BOX"

config ESP32_S3_BOX_LITE_BOARD
    bool "ESP32-S3-BOX-Lite"

config ESP32_S3_BOX_3_BOARD
    bool "ESP32-S3-BOX-3"

config M5STACK_CORE_S3_BOARD
    bool "M5Stack CoreS3"

endchoice

config WIFI_SSID
    string "WiFi SSID"
    depends on !WILLOW_ETHERNET
    default "myssid"
    help
        SSID (network name) for Willow to connect to.

config WIFI_PASSWORD
    string "WiFi Password"
    depends on !WILLOW_ETHERNET
    default "mypassword"
    help
        WiFi password (WPA, WPA2, WPA3) for Willow to use.

        Can be left blank if the network is open.

config WILLOW_WAS_URL
    string "Willow Application Server URL"
    default "wss://was.local"
    help
        URL for your WAS instance. Supports WS and WSS.

    menu "Advanced settings"

        config WILLOW_ETHERNET
        depends on ETH_SPI_ETHERNET_W5500
        bool "Ethernet support"
        help
            Ethernet support via W5500 over SPI

    endmenu

    menu "Debugging"

    config WILLOW_DEBUG_LOG
        bool "Debug Willow logging"
        help
            Set all log levels to debug

    config WILLOW_DEBUG_MEM
        bool "Debug Willow memory"
        help
            Willow will periodically print memory debugging information when enabled

    config WILLOW_DEBUG_RUNTIME_STATS
        bool "Debug Willow runtime stats"
        select FREERTOS_GENERATE_RUN_TIME_STATS
        help
            Willow will periodically print runtime stats when enabled

    config WILLOW_DEBUG_TASKS
        bool "Debug Willow tasks"
        select FREERTOS_USE_STATS_FORMATTING_FUNCTIONS
        select FREERTOS_USE_TRACE_FACILITY
        help
            Willow will periodically print task list when enabled

    config WILLOW_DEBUG_TIMERS
        bool "Debug Willow timers"
        help
            Willow will periodically print timer information when enabled

    endmenu

endmenu
```

## sdkconfig.defaults
```kconfig
# Reasons for choosing some of these values can be found in the git history:
# git log -- sdkconfig.willow

CONFIG_ADC_SUPPRESS_DEPRECATE_WARN=y
# CONFIG_BOOTLOADER_APP_ANTI_ROLLBACK is not set
CONFIG_BOOTLOADER_APP_ROLLBACK_ENABLE=y
CONFIG_BOOTLOADER_COMPILER_OPTIMIZATION_PERF=y
CONFIG_COMPILER_OPTIMIZATION_PERF=y
# CONFIG_CODEC_I2C_BACKWARD_COMPATIBLE is not set
CONFIG_ESP32S3_DATA_CACHE_64KB=y
CONFIG_ESP32S3_DATA_CACHE_LINE_64B=y
CONFIG_ESP32S3_INSTRUCTION_CACHE_32KB=y
CONFIG_ESP32_S3_BOX_3_BOARD=y
CONFIG_ESPTOOLPY_FLASHSIZE_16MB=y
CONFIG_ESPTOOLPY_MONITOR_BAUD=2000000
CONFIG_ESP_DEFAULT_CPU_FREQ_MHZ_240=y
CONFIG_ESP_HTTP_CLIENT_ENABLE_BASIC_AUTH=y
CONFIG_ESP_MAIN_TASK_STACK_SIZE=16384
# CONFIG_ESP_PHY_CALIBRATION_AND_DATA_STORAGE is not set
CONFIG_ESP_PHY_RF_CAL_FULL=y
CONFIG_ESP_TASK_WDT_PANIC=y
CONFIG_ESP_TASK_WDT_TIMEOUT_S=10
CONFIG_ESP_TLS_CLIENT_SESSION_TICKETS=y
CONFIG_ESP_TLS_INSECURE=y
CONFIG_ESP_TLS_SKIP_SERVER_CERT_VERIFY=y
CONFIG_ESP_WIFI_11KV_SUPPORT=y
CONFIG_ESP_WIFI_AMSDU_TX_ENABLED=y
CONFIG_ESP_WIFI_MBO_SUPPORT=y
# CONFIG_ESP_WIFI_NVS_ENABLED is not set
CONFIG_ESP_WIFI_RX_BA_WIN=6
CONFIG_ESP_WIFI_SCAN_CACHE=y
# CONFIG_ESP_WIFI_SOFTAP_SUPPORT is not set
CONFIG_ESP_WIFI_STATIC_RX_BUFFER_NUM=10
CONFIG_FREERTOS_ENABLE_BACKWARD_COMPATIBILITY=y
CONFIG_FREERTOS_HZ=1000
CONFIG_GDMA_CTRL_FUNC_IN_IRAM=y
CONFIG_GPTIMER_SUPPRESS_DEPRECATE_WARN=y
CONFIG_I2C_SKIP_LEGACY_CONFLICT_CHECK=y
CONFIG_I2S_SUPPRESS_DEPRECATE_WARN=y
# CONFIG_LCD_RGB_ISR_IRAM_SAFE is not set
CONFIG_LOG_TIMESTAMP_SOURCE_SYSTEM=y
# CONFIG_LWIP_DHCPS is not set
CONFIG_LWIP_DHCP_GET_NTP_SRV=y
CONFIG_LWIP_DHCP_MAX_NTP_SERVERS=1
CONFIG_LWIP_LOCAL_HOSTNAME="willow"
CONFIG_LWIP_TCPIP_TASK_AFFINITY_CPU0=y
CONFIG_LWIP_TCP_RECVMBOX_SIZE=18
CONFIG_LWIP_TCP_SACK_OUT=y
CONFIG_LWIP_TCP_SND_BUF_DEFAULT=23040
CONFIG_LWIP_TCP_WND_DEFAULT=23040
CONFIG_MBEDTLS_CERTIFICATE_BUNDLE_MAX_CERTS=1000
CONFIG_MBEDTLS_CHACHA20_C=y
CONFIG_MBEDTLS_CHACHAPOLY_C=y
CONFIG_MBEDTLS_EXTERNAL_MEM_ALLOC=y
CONFIG_MBEDTLS_HARDWARE_AES=y
# CONFIG_MBEDTLS_HARDWARE_MPI is not set
# CONFIG_MBEDTLS_HARDWARE_SHA is not set
CONFIG_MBEDTLS_POLY1305_C=y
CONFIG_MBEDTLS_SSL_PROTO_TLS1_3=y
CONFIG_MBEDTLS_TLS_CLIENT_ONLY=y
# CONFIG_MEDIA_PROTOCOL_LIB_ENABLE is not set
CONFIG_PARTITION_TABLE_CUSTOM=y
CONFIG_PARTITION_TABLE_CUSTOM_FILENAME="partitions_willow.csv"
CONFIG_PARTITION_TABLE_FILENAME="partitions_willow.csv"
CONFIG_PTHREAD_DEFAULT_CORE_0=y
CONFIG_RMT_SUPPRESS_DEPRECATE_WARN=y
CONFIG_SPIFFS_MAX_PARTITIONS=6
CONFIG_SPIRAM=y
CONFIG_SPIRAM_ALLOW_STACK_EXTERNAL_MEMORY=y
CONFIG_SPIRAM_ECC_ENABLE=y
CONFIG_SPIRAM_FETCH_INSTRUCTIONS=y
# CONFIG_SPIRAM_IGNORE_NOTFOUND is not set
CONFIG_SPIRAM_MALLOC_ALWAYSINTERNAL=0
CONFIG_SPIRAM_MALLOC_RESERVE_INTERNAL=32768
CONFIG_SPIRAM_MODE_OCT=y
CONFIG_SPIRAM_RODATA=y
CONFIG_SPIRAM_SPEED_80M=y
# CONFIG_SPIRAM_TRY_ALLOCATE_WIFI_LWIP is not set
CONFIG_SPI_MASTER_IN_IRAM=y
CONFIG_SPI_SLAVE_IN_IRAM=y
CONFIG_SR_MN_CN_NONE=y
CONFIG_SR_MN_EN_NONE=y
CONFIG_SR_WN_LOAD_MULIT_WORD=y
CONFIG_SR_WN_WN9_ALEXA_MULTI=y
CONFIG_SR_WN_WN9_HIESP_MULTI=y
CONFIG_SR_WN_WN9_HILEXIN_MULTI=y
```
